## board/common/buildroot/package/xash3d-fwgs/Config.in
```kconfig
config BR2_PACKAGE_XASH3D_FWGS
	bool "xash3d-fwgs"
	depends on BR2_INSTALL_LIBSTDCPP # menu
	depends on BR2_TOOLCHAIN_HAS_THREADS
	depends on BR2_USE_MMU # fork()
	depends on !BR2_STATIC_LIBS # game libraries are dlopen()ed
	depends on BR2_PACKAGE_BARE_APP
	select BR2_PACKAGE_ALSA_LIB
	select BR2_PACKAGE_ZLIB
	help
	  Xash3D FWGS, an engine compatible with GoldSource (Half-Life),
	  built as a game of bare_app: frames and gamepad over
	  bare_app's socket and shared memory
	  (0001-engine-bare_app-platform.patch), sound to ALSA, no SDL.
	  The software renderer, and with mesa-panfrost the OpenGL ES
	  one, drawn off screen by the GPU.
	  The launcher /usr/bin/xash3d, the engine, renderer and menu in
	  /usr/lib/xash3d, the engine's resources in
	  /usr/share/xash3d/valve/extras.pk3, with our Russian for the
	  menus and the game's messages (russian/). The game code comes
	  from hlsdk-portable, the game files from a bought copy.

	  https://github.com/FWGS/xash3d-fwgs

comment "xash3d-fwgs needs bare_app and a toolchain w/ C++, threads, dynamic library"
	depends on BR2_USE_MMU
	depends on !BR2_PACKAGE_BARE_APP || !BR2_INSTALL_LIBSTDCPP || \
		!BR2_TOOLCHAIN_HAS_THREADS || BR2_STATIC_LIBS
```

## board/oga/buildroot/configs/oga_defconfig
```kconfig
BR2_aarch64=y
BR2_cortex_a35=y
BR2_TOOLCHAIN_BUILDROOT_GLIBC=y
BR2_TOOLCHAIN_BUILDROOT_CXX=y
BR2_PACKAGE_HOST_GDB=y
BR2_TARGET_GENERIC_HOSTNAME="odroid-go"
BR2_TARGET_GENERIC_ISSUE="Welcome to ODROID-GO Advance"
BR2_ROOTFS_DEVICE_CREATION_DYNAMIC_MDEV=y
BR2_TARGET_GENERIC_GETTY_PORT="ttyS2"
BR2_TARGET_GENERIC_GETTY_BAUDRATE_115200=y
BR2_SYSTEM_DHCP=""
BR2_ROOTFS_OVERLAY="$(BR2_EXTERNAL_OGA_PATH)/rootfs-overlay"
BR2_ROOTFS_POST_BUILD_SCRIPT="$(BR2_EXTERNAL_OGA_PATH)/post-build.sh"
BR2_PACKAGE_ALSA_UTILS=y
BR2_PACKAGE_EVTEST=y
BR2_PACKAGE_GDB=y
BR2_PACKAGE_KMOD=y
BR2_PACKAGE_KMOD_TOOLS=y
BR2_TARGET_ROOTFS_TAR=y
BR2_PACKAGE_HOST_MTOOLS=y
```

## board/oga/buildroot/defconfig
```kconfig
BR2_aarch64=y
BR2_cortex_a35=y
BR2_TOOLCHAIN_BUILDROOT_GLIBC=y
BR2_TOOLCHAIN_BUILDROOT_CXX=y
BR2_TOOLCHAIN_GLIBC_GCONV_LIBS_COPY=y
BR2_TOOLCHAIN_GLIBC_GCONV_LIBS_LIST="CP1250 CP1251 CP1252"
BR2_PACKAGE_HOST_GDB=y
BR2_TARGET_GENERIC_HOSTNAME="odroid-go"
BR2_TARGET_GENERIC_ISSUE="Welcome to ODROID-GO Advance"
BR2_ROOTFS_DEVICE_CREATION_DYNAMIC_MDEV=y
BR2_TARGET_GENERIC_GETTY_PORT="ttyS2"
BR2_TARGET_GENERIC_GETTY_BAUDRATE_115200=y
BR2_SYSTEM_DHCP=""
BR2_GENERATE_LOCALE="en_US.UTF-8 ru_RU.UTF-8"
BR2_ROOTFS_OVERLAY="$(BR2_EXTERNAL_SDK_PATH)/rootfs-overlay $(BR2_EXTERNAL_SDK_PATH)/../../oga/buildroot/rootfs-overlay"
BR2_ROOTFS_POST_BUILD_SCRIPT="$(BR2_EXTERNAL_SDK_PATH)/post-build.sh $(BR2_EXTERNAL_SDK_PATH)/../../oga/buildroot/post-build.sh"
BR2_ROOTFS_POST_SCRIPT_ARGS="tty1"
BR2_PACKAGE_BUSYBOX_CONFIG_FRAGMENT_FILES="$(BR2_EXTERNAL_SDK_PATH)/busybox.fragment"
BR2_PACKAGE_ALSA_UTILS=y
BR2_PACKAGE_E2FSPROGS=y
BR2_PACKAGE_EVTEST=y
BR2_PACKAGE_GDB=y
BR2_PACKAGE_KMOD=y
BR2_PACKAGE_KMOD_TOOLS=y
BR2_PACKAGE_UTIL_LINUX=y
BR2_PACKAGE_UTIL_LINUX_BINARIES=y
BR2_PACKAGE_UTIL_LINUX_PARTX=y
BR2_PACKAGE_DROPBEAR=y
BR2_PACKAGE_IW=y
BR2_PACKAGE_WIRELESS_REGDB=y
BR2_PACKAGE_WPA_SUPPLICANT=y
BR2_PACKAGE_WPA_SUPPLICANT_CLI=y
BR2_PACKAGE_WPA_SUPPLICANT_PASSPHRASE=y
BR2_TARGET_ROOTFS_TAR=y
BR2_PACKAGE_HOST_MTOOLS=y
BR2_PACKAGE_ESP8089_FIRMWARE=y
```

## board/rpi4/buildroot/defconfig
```kconfig
BR2_aarch64=y
BR2_cortex_a72=y
BR2_TOOLCHAIN_BUILDROOT_GLIBC=y
BR2_TOOLCHAIN_BUILDROOT_CXX=y
BR2_PACKAGE_HOST_GDB=y
BR2_TARGET_GENERIC_HOSTNAME="raspberrypi"
BR2_TARGET_GENERIC_ISSUE="Welcome to Raspberry Pi 4 / 400"
BR2_TARGET_GENERIC_GETTY_PORT="ttyS1"
BR2_TARGET_GENERIC_GETTY_BAUDRATE_115200=y
BR2_SYSTEM_DHCP="eth0"
BR2_PACKAGE_ALSA_UTILS=y
BR2_PACKAGE_EVTEST=y
BR2_ROOTFS_DEVICE_CREATION_DYNAMIC_MDEV=y
BR2_ROOTFS_OVERLAY="$(BR2_EXTERNAL_SDK_PATH)/rootfs-overlay"
BR2_ROOTFS_POST_BUILD_SCRIPT="$(BR2_EXTERNAL_SDK_PATH)/post-build.sh"
BR2_ROOTFS_POST_SCRIPT_ARGS="tty1"
BR2_PACKAGE_BUSYBOX_CONFIG_FRAGMENT_FILES="$(BR2_EXTERNAL_SDK_PATH)/busybox.fragment"
BR2_PACKAGE_GDB=y
BR2_PACKAGE_KMOD=y
BR2_PACKAGE_KMOD_TOOLS=y
BR2_PACKAGE_DROPBEAR=y
BR2_TARGET_ROOTFS_TAR=y
BR2_PACKAGE_HOST_MTOOLS=y
```

## docs/dev-book/examples/package/sdk-hello/Config.in
```kconfig
config BR2_PACKAGE_SDK_HELLO
	bool "sdk-hello"
	help
	  OdroidLinux SDK example: a small C program built from a
	  local source directory (apps/hello in the SDK), plus an init
	  script that runs it at boot.
```

## docs/dev-book/examples/uboot/cmd/Kconfig.snippet
```kconfig
config CMD_SDKINFO
	bool "sdkinfo"
	default n
	help
	  Print the board name, the dtb U-Boot selected for Linux and the
	  RAM size (OdroidLinux SDK example).
```
