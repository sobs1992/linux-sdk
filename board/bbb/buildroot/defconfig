## board/bbb/buildroot/defconfig
```kconfig
BR2_arm=y
BR2_cortex_a8=y
BR2_ARM_FPU_NEON=y
BR2_TOOLCHAIN_BUILDROOT_GLIBC=y
BR2_TOOLCHAIN_BUILDROOT_CXX=y
BR2_PACKAGE_HOST_GDB=y
BR2_TARGET_GENERIC_HOSTNAME="beaglebone"
BR2_TARGET_GENERIC_ISSUE="Welcome to BeagleBone Black"
BR2_TARGET_GENERIC_GETTY_PORT="ttyS0"
BR2_TARGET_GENERIC_GETTY_BAUDRATE_115200=y
BR2_SYSTEM_DHCP="eth0"
BR2_ROOTFS_DEVICE_CREATION_DYNAMIC_MDEV=y
BR2_ROOTFS_OVERLAY="$(BR2_EXTERNAL_SDK_PATH)/rootfs-overlay"
BR2_ROOTFS_POST_BUILD_SCRIPT="$(BR2_EXTERNAL_SDK_PATH)/post-build.sh"
BR2_ROOTFS_POST_SCRIPT_ARGS="tty1"
BR2_PACKAGE_BUSYBOX_CONFIG_FRAGMENT_FILES="$(BR2_EXTERNAL_SDK_PATH)/busybox.fragment"
BR2_PACKAGE_GDB=y
BR2_PACKAGE_KMOD=y
BR2_PACKAGE_KMOD_TOOLS=y
BR2_PACKAGE_DROPBEAR=y
BR2_TARGET_ROOTFS_TAR=y
BR2_PACKAGE_HOST_MTOOLS=y
```

## board/common/buildroot/package/bare-app/Config.in
```kconfig
config BR2_PACKAGE_BARE_APP
	bool "bare_app"
	help
	  LVGL GUI application for the SDK (display, gamepad, battery,
	  backlight, Doom with GAME_DOOM). Source: apps/bare_app (git
	  submodule). Doom is a separate program, /usr/bin/bare_app_doom,
	  under GPLv2 (apps/bare_app/ports/doom); bare_app itself has no
	  GPL code.

if BR2_PACKAGE_BARE_APP

config BR2_PACKAGE_BARE_APP_DEFCONFIG
	string "bare_app configuration"
	default "oga_defconfig"
	help
	  What goes into the binary (bare_app's own Kconfig): a name in
	  apps/bare_app/configs/ or a path to a defconfig file. In the SDK
	  set it from the firmware config:
	  APPS_CONFIG := bare-app.DEFCONFIG=oga_defconfig

config BR2_PACKAGE_BARE_APP_AUTOSTART
	bool "start at boot"
	help
	  Start bare_app from /etc/init.d/S90bare-app. It takes over the
	  screen (the text console on tty1 comes back when it quits;
	  Quit in its menu turns the device off where the platform has a
	  poweroff command).
	  Log: /var/log/bare_app.log. In the SDK: APPS_AUTOSTART.

config BR2_PACKAGE_BARE_APP_DOOM_WAD
	bool "install the shareware Doom WAD"
	select BR2_PACKAGE_DOOM1_WAD
	help
	  doom1.wad (Doom 1.9 shareware, episode 1) in
	  /usr/share/games/doom/, where GAME_DOOM looks by default. Other
	  IWADs (doom.wad, doom2.wad) can be copied there by hand and
	  chosen with GAME_DOOM_WAD. In the SDK:
	  APPS_CONFIG += bare-app.DOOM_WAD=y

config BR2_PACKAGE_BARE_APP_HOMM3
	bool "Heroes of Might and Magic III (VCMI)"
	depends on BR2_INSTALL_LIBSTDCPP
	depends on BR2_TOOLCHAIN_GCC_AT_LEAST_11
	depends on BR2_TOOLCHAIN_HAS_THREADS
	depends on BR2_USE_WCHAR
	depends on !BR2_STATIC_LIBS
	depends on !BR2_TOOLCHAIN_USES_UCLIBC
	depends on BR2_TOOLCHAIN_SUPPORTS_ALWAYS_LOCKFREE_ATOMIC_INTS
	select BR2_PACKAGE_VCMI
	help
	  The VCMI engine (package vcmi, GPLv2) for Heroes III. The game
	  data is not included: copy Data, Maps and Mp3 of an original
	  installation to heroes3/ of the games partition (GAMES, /games),
	  from a PC or with scripts/homm3-install.sh. Also switches
	  bare_app's GAME_HOMM3 on. In the SDK:
	  APPS_CONFIG += bare-app.HOMM3=y

config BR2_PACKAGE_BARE_APP_HALFLIFE
	bool "Half-Life (Xash3D FWGS)"
	depends on BR2_INSTALL_LIBSTDCPP
	depends on BR2_TOOLCHAIN_HAS_THREADS
	depends on BR2_USE_MMU
	depends on !BR2_STATIC_LIBS
	select BR2_PACKAGE_XASH3D_FWGS
	select BR2_PACKAGE_HLSDK_PORTABLE
	# the GPU renderer
	select BR2_PACKAGE_MESA_PANFROST if BR2_TOOLCHAIN_HAS_SYNC_4
	help
	  The Xash3D FWGS engine (package xash3d-fwgs, GPLv3) and the
	  game code of hlsdk-portable (Valve's SDK licence) for
	  Half-Life, drawn by the GPU (mesa-panfrost). The game files
	  are not included: copy the valve directory of a bought copy,
	  and valve_russian for Russian menus, to halflife/ of the games
	  partition (GAMES, /games), from a PC or with
	  scripts/halflife-install.sh.
	  Also switches bare_app's GAME_HALFLIFE on. In the SDK:
	  APPS_CONFIG += bare-app.HALFLIFE=y

config BR2_PACKAGE_BARE_APP_WINE
	bool "Windows games (Wine)"
	depends on BR2_aarch64
	depends on BR2_HOSTARCH = "x86_64" # prebuilt llvm-mingw
	depends on !BR2_STATIC_LIBS
	depends on BR2_TOOLCHAIN_HAS_THREADS_NPTL
	select BR2_PACKAGE_WINE_WOW64
	# OpenGL for Direct3D (WineD3D)
	select BR2_PACKAGE_MESA_PANFROST if BR2_TOOLCHAIN_HAS_SYNC_4
	help
	  Wine for 32-bit x86 Windows games (package wine-wow64, LGPL,
	  with Box64's wowbox64.dll, MIT) and its winebare.drv driver,
	  played by bare_app_wine. Each game is a directory of the games
	  partition (GAMES, /games) with a wine.ini, which names the
	  program and the controls (apps/bare_app/ports/wine/wine.ini).
	  Also switches bare_app's GAME_WINE on. In the SDK:
	  APPS_CONFIG += bare-app.WINE=y

config BR2_PACKAGE_BARE_APP_SDL
	bool "SDL2 games (SDL's bareapp drivers)"
	depends on !BR2_STATIC_LIBS # sdl2
	select BR2_PACKAGE_SDL2
	help
	  SDL2 with the video and joystick drivers "bareapp" (patch in
	  sdl2/): an SDL2 game started by bare_app draws into its video
	  layer and gets its gamepad as a game controller, unchanged.
	  The window is fitted to the layer; OpenGL ES is drawn by the
	  GPU (mesa-panfrost) off screen. Such a game is an entry of the
	  main menu by a game.ini (bare_app's GAME_NATIVE,
	  apps/bare_app/docs/game.ini): a package installs one in
	  /usr/share/bare_app/games/. In the SDK:
	  APPS_CONFIG += bare-app.SDL=y

	  SDL2 is not rebuilt by itself when this changes: run
	  "make rootfs-make BR=sdl2-dirclean" first.

config BR2_PACKAGE_BARE_APP_CHOCOLATE_DOOM
	bool "Chocolate Doom (an SDL2 game by its game.ini)"
	depends on BR2_PACKAGE_BARE_APP_SDL
	depends on BR2_USE_MMU # chocolate-doom
	select BR2_PACKAGE_CHOCOLATE_DOOM
	select BR2_PACKAGE_SDL2_MIXER # sound and OPL music
	select BR2_PACKAGE_DOOM1_WAD
	help
	  Buildroot's chocolate-doom as it is, with the shareware
	  doom1.wad: games/chocolate-doom.ini (installed in
	  /usr/share/bare_app/games/) is all it takes to make it an
	  entry of bare_app's menu, the example of an SDL2 game. In the
	  SDK: APPS_CONFIG += bare-app.CHOCOLATE_DOOM=y

endif
```

## board/common/buildroot/package/doom1-wad/Config.in
```kconfig
config BR2_PACKAGE_DOOM1_WAD
	bool
	help
	  Shareware Doom WAD (doom1.wad, version 1.9) in
	  /usr/share/games/doom/. Buildroot's doom-wad installs the same
	  file but only for its own Doom ports; this one is selected by
	  BR2_PACKAGE_BARE_APP_DOOM_WAD.

	  https://doomwiki.org/wiki/DOOM1.WAD
```

## board/common/buildroot/package/esp8089-firmware/Config.in
```kconfig
config BR2_PACKAGE_ESP8089_FIRMWARE
	bool "esp8089-firmware"
	help
	  Firmware for the Espressif ESP8089 SDIO Wi-Fi chip (ODROID-GO
	  Advance Black Edition), loaded by the esp8089 driver from
	  /lib/firmware.

	  https://github.com/armbian/firmware
```

## board/common/buildroot/package/hlsdk-portable/Config.in
```kconfig
config BR2_PACKAGE_HLSDK_PORTABLE
	bool "hlsdk-portable"
	depends on BR2_INSTALL_LIBSTDCPP
	depends on !BR2_STATIC_LIBS
	help
	  The game code of Half-Life (Valve's Half-Life 1 SDK, ported by
	  the Xash3D FWGS project) for the engine of xash3d-fwgs: the
	  server and client libraries, in /usr/lib/xash3d/valve/dlls
	  and cl_dlls (their names carry the architecture:
	  hl_arm64.so). Under Valve's SDK licence: free, non-commercial.

	  https://github.com/FWGS/hlsdk-portable

comment "hlsdk-portable needs a toolchain w/ C++, dynamic library"
	depends on !BR2_INSTALL_LIBSTDCPP || BR2_STATIC_LIBS
```

## board/common/buildroot/package/mesa-panfrost/Config.in
```kconfig
config BR2_PACKAGE_MESA_PANFROST
	bool "mesa-panfrost"
	depends on BR2_TOOLCHAIN_HAS_THREADS
	depends on BR2_TOOLCHAIN_HAS_SYNC_4
	depends on !BR2_STATIC_LIBS
	depends on !BR2_PACKAGE_MESA3D # the same libraries
	select BR2_PACKAGE_LIBDRM
	select BR2_PACKAGE_ZLIB
	help
	  Mesa 25.0 with only the panfrost driver (ARM Mali Midgard,
	  Bifrost: the GO Ultra's G52, the OGA's G31), EGL, GLES 2/3 and
	  GBM, no window system: for rendering off screen on the render
	  node. Buildroot's mesa3d (26.x) builds panfrost only with LLVM,
	  clang and libclc for the host and the target; 25.0 needs none
	  of them.

	  https://www.mesa3d.org/

comment "mesa-panfrost needs a toolchain w/ threads, sync_4, dynamic library"
	depends on !BR2_TOOLCHAIN_HAS_THREADS || !BR2_TOOLCHAIN_HAS_SYNC_4 || BR2_STATIC_LIBS
```

## board/common/buildroot/package/meson-venc-firmware/Config.in
```kconfig
config BR2_PACKAGE_MESON_VENC_FIRMWARE
	bool "meson-venc-firmware"
	help
	  Microcode of the HCODEC H.264 encoder of Amlogic G12A/G12B
	  (ga_h264_enc_cabac, Amlogic), for the meson-venc kernel driver:
	  /lib/firmware/meson/venc/g12a_h264_enc_cabac.bin. Taken out of
	  the firmware package h264_enc.bin of Amlogic's media_modules
	  (CoreELEC's copy); not in linux-firmware.

	  https://github.com/CoreELEC/media_modules-aml
```

## board/common/buildroot/package/oga-pad/Config.in
```kconfig
config BR2_PACKAGE_OGA_PAD
	bool "oga-pad"
	help
	  Demo for the ODROID-GO Advance: move a square across the
	  screen with the D-pad (evdev + framebuffer). Source: apps/oga-pad.

config BR2_PACKAGE_OGA_PAD_AUTOSTART
	bool "start at boot"
	depends on BR2_PACKAGE_OGA_PAD
	help
	  Start oga-pad from /etc/init.d/S90oga-pad; F6 quits it and gives
	  the screen back to the text console. Log: /var/log/oga-pad.log.
```

## board/common/buildroot/package/rbdoom3-bfg/Config.in
```kconfig
config BR2_PACKAGE_RBDOOM3_BFG
	bool "rbdoom3-bfg"
	depends on BR2_aarch64 || BR2_x86_64 # neo/sys/sys_defines.h
	depends on BR2_INSTALL_LIBSTDCPP
	depends on BR2_TOOLCHAIN_HAS_THREADS_NPTL # openal
	depends on BR2_TOOLCHAIN_GCC_AT_LEAST_7 # openal
	depends on BR2_PACKAGE_OPENAL_ARCH_SUPPORTS
	depends on !BR2_STATIC_LIBS # sdl2
	depends on BR2_PACKAGE_MESA_PANFROST # OpenGL through EGL
	# SDL2 with EGL and its bareapp video driver: the only window there is
	depends on BR2_PACKAGE_BARE_APP_SDL
	select BR2_PACKAGE_SDL2
	select BR2_PACKAGE_OPENAL
	select BR2_PACKAGE_ZLIB
	help
	  RBDOOM-3-BFG 1.2.0 (GPLv3), the engine of DOOM 3 BFG Edition,
	  an SDL2 game for bare_app: its OpenGL renderer drawn by the
	  GPU (mesa-panfrost) through SDL's bareapp driver, sound by
	  OpenAL Soft, the Bink videos by its own libbinkdec. The game
	  files (base/ of a bought BFG Edition) are not included.

	  https://github.com/RobertBeckebans/RBDOOM-3-BFG

comment "rbdoom3-bfg needs mesa-panfrost, bare_app's SDL2 games and a toolchain w/ C++, NPTL, gcc >= 7, dynamic library"
	depends on BR2_aarch64 || BR2_x86_64
	depends on BR2_PACKAGE_OPENAL_ARCH_SUPPORTS
	depends on !BR2_PACKAGE_MESA_PANFROST || !BR2_PACKAGE_BARE_APP_SDL || \
		!BR2_INSTALL_LIBSTDCPP || !BR2_TOOLCHAIN_HAS_THREADS_NPTL || \
		!BR2_TOOLCHAIN_GCC_AT_LEAST_7 || BR2_STATIC_LIBS
```

## board/common/buildroot/package/vcmi/Config.in
```kconfig
config BR2_PACKAGE_VCMI
	bool "vcmi"
	depends on BR2_INSTALL_LIBSTDCPP
	depends on BR2_TOOLCHAIN_GCC_AT_LEAST_11 # C++20
	depends on BR2_TOOLCHAIN_HAS_THREADS
	depends on BR2_USE_WCHAR
	depends on !BR2_STATIC_LIBS
	depends on !BR2_TOOLCHAIN_USES_UCLIBC # tbb
	depends on BR2_TOOLCHAIN_SUPPORTS_ALWAYS_LOCKFREE_ATOMIC_INTS # boost-locale
	depends on BR2_PACKAGE_FFMPEG_ARCH_SUPPORTS
	select BR2_PACKAGE_BOOST
	select BR2_PACKAGE_BOOST_DATE_TIME
	select BR2_PACKAGE_BOOST_FILESYSTEM
	select BR2_PACKAGE_BOOST_LOCALE
	select BR2_PACKAGE_BOOST_PROGRAM_OPTIONS
	select BR2_PACKAGE_FFMPEG
	select BR2_PACKAGE_FFMPEG_SWSCALE
	select BR2_PACKAGE_LIBSQUISH
	select BR2_PACKAGE_LIBPNG
	select BR2_PACKAGE_MINIZIP_ZLIB
	select BR2_PACKAGE_SDL2
	select BR2_PACKAGE_SDL2_IMAGE
	select BR2_PACKAGE_SDL2_MIXER
	select BR2_PACKAGE_SDL2_TTF
	select BR2_PACKAGE_TBB
	select BR2_PACKAGE_ZLIB
	help
	  VCMI, an open-source engine for Heroes of Might and Magic III:
	  the client (vcmiclient, with the game server built in), the
	  adventure AI Nullkiller2 and the battle AIs BattleAI and
	  StupidAI. No launcher, map editor or Lua.

	  The game data is not included: VCMI needs the Data, Maps and
	  Mp3 directories of an original installation (Shadow of Death
	  or Complete) in its data directory.

	  SDL2 gets its dummy video driver (VCMI draws in software into
	  a window kept in memory) and SDL2_mixer MP3 support (the
	  game's music). FFmpeg is built with what the game's videos
	  need only: Bink and Smacker.

	  https://vcmi.eu/

comment "vcmi needs a glibc/musl toolchain w/ C++, gcc >= 11, threads, wchar, dynamic library"
	depends on !BR2_INSTALL_LIBSTDCPP || !BR2_TOOLCHAIN_GCC_AT_LEAST_11 || \
		!BR2_TOOLCHAIN_HAS_THREADS || !BR2_USE_WCHAR || BR2_STATIC_LIBS || \
		BR2_TOOLCHAIN_USES_UCLIBC
```

## board/common/buildroot/package/wine-wow64/Config.in
```kconfig
config BR2_PACKAGE_WINE_WOW64
	bool "wine-wow64"
	depends on BR2_aarch64
	depends on BR2_HOSTARCH = "x86_64" # prebuilt llvm-mingw
	depends on !BR2_STATIC_LIBS
	depends on BR2_TOOLCHAIN_HAS_THREADS_NPTL
	depends on BR2_PACKAGE_BARE_APP # winebare.drv's protocol
	select BR2_PACKAGE_ALSA_LIB
	select BR2_PACKAGE_FREETYPE
	select BR2_PACKAGE_WOWBOX64 # the x86 CPU named by wine.inf (0001)
	# winegstreamer: DirectShow and Media Foundation decoding (WMA,
	# MP3, AVI... of old games), its elements and the codecs of FFmpeg
	select BR2_PACKAGE_GSTREAMER1
	select BR2_PACKAGE_GST1_PLUGINS_BASE
	select BR2_PACKAGE_GST1_PLUGINS_BASE_PLUGIN_AUDIOCONVERT
	select BR2_PACKAGE_GST1_PLUGINS_BASE_PLUGIN_AUDIORESAMPLE
	select BR2_PACKAGE_GST1_PLUGINS_BASE_PLUGIN_PLAYBACK # decodebin
	select BR2_PACKAGE_GST1_PLUGINS_BASE_PLUGIN_TYPEFIND
	select BR2_PACKAGE_GST1_PLUGINS_BASE_PLUGIN_VIDEOCONVERTSCALE
	select BR2_PACKAGE_GST1_PLUGINS_GOOD
	select BR2_PACKAGE_GST1_PLUGINS_GOOD_PLUGIN_AUDIOPARSERS # MP3
	select BR2_PACKAGE_GST1_PLUGINS_GOOD_PLUGIN_AVI
	select BR2_PACKAGE_GST1_PLUGINS_GOOD_PLUGIN_DEINTERLACE
	select BR2_PACKAGE_GST1_PLUGINS_GOOD_PLUGIN_ID3DEMUX
	select BR2_PACKAGE_GST1_PLUGINS_GOOD_PLUGIN_VIDEOFILTER # videoflip
	select BR2_PACKAGE_GST1_PLUGINS_GOOD_PLUGIN_WAVPARSE
	select BR2_PACKAGE_GST1_PLUGINS_UGLY
	select BR2_PACKAGE_GST1_PLUGINS_UGLY_PLUGIN_ASFDEMUX # WMA, WMV
	select BR2_PACKAGE_GST1_LIBAV # aarch64: FFmpeg is there
	help
	  Wine 11 for arm64 in the WoW64 mode, for 32-bit x86 Windows
	  programs: the Unix side and the 64-bit Windows dlls native,
	  the 32-bit dlls i386, their x86 code run by Box64's
	  wowbox64.dll. PE dlls built by llvm-mingw, aarch64 ones
	  aligned to 4 KiB in the file (0002). No X11 or Wayland;
	  sound by ALSA, OpenGL through EGL with mesa-panfrost,
	  media decoding by GStreamer.

	  https://www.winehq.org

comment "wine-wow64 needs a toolchain w/ dynamic library, NPTL"
	depends on BR2_aarch64
	depends on BR2_STATIC_LIBS || !BR2_TOOLCHAIN_HAS_THREADS_NPTL
```

## board/common/buildroot/package/wowbox64/Config.in
```kconfig
config BR2_PACKAGE_WOWBOX64
	bool "wowbox64"
	depends on BR2_aarch64
	depends on BR2_HOSTARCH = "x86_64" # prebuilt llvm-mingw
	help
	  Box64's WoW64 build, wowbox64.dll: the x86 CPU that runs the
	  32-bit Windows programs of wine-wow64 on arm64 (Wine's
	  HKLM\Software\Microsoft\Wow64\x86 names it). Built by
	  llvm-mingw; installed in /usr/lib/wine/aarch64-windows.

	  https://github.com/ptitSeb/box64
```
