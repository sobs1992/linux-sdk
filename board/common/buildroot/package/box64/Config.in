## board/common/buildroot/package/box64/Config.in
```kconfig
config BR2_PACKAGE_BOX64
	bool "box64"
	depends on BR2_aarch64
	depends on !BR2_STATIC_LIBS # it loads the native libraries it wraps
	help
	  Box64 runs x86_64 Linux programs on arm64: their code through
	  its dynamic recompiler, the libraries it knows (libc, libm,
	  libGL, SDL 1.2 and 2, OpenAL...) as the system's native ones.
	  Built for the Odroid-N2 (S922X: Cortex-A73 + A53) as the GO
	  Ultra is. Installed as /usr/bin/box64 with the x86_64
	  libstdc++.so.5/.6 and libgcc_s.so.1 of its x64lib in
	  /usr/lib/box64-x86_64-linux-gnu (old games' C++ runtime).

	  https://github.com/ptitSeb/box64
```

## board/common/buildroot/package/cabextract/Config.in
```kconfig
config BR2_PACKAGE_CABEXTRACT
	bool "cabextract"
	help
	  Unpacks Microsoft cabinet files (.cab): the DirectX
	  redistributables in GOG's installers (__redist/DirectX) and
	  Microsoft's DirectX package, from which the device's
	  game-install takes the Windows DLLs a game's recipe needs.

	  https://www.cabextract.org.uk/
```

## board/common/buildroot/package/ddr-tools/Config.in
```kconfig
config BR2_PACKAGE_DDR_TOOLS
	bool "ddr-tools"
	depends on BR2_aarch64
	depends on BR2_TOOLCHAIN_HAS_THREADS
	help
	  The read eye of the Amlogic G12B's DDR PHY at run time
	  (docs/boards/ogu.md, "Память: подстройка задержек чтения"):
	  ddr-phyreg (read and write its registers), ddr-eyescan (move
	  one delay until memory reads wrong) and ddr-calibrate (find
	  the lanes BL2's training leaves off-centre; ddr-tune keeps the
	  result for U-Boot).
```

## board/common/buildroot/package/game-frame/Config.in
```kconfig
config BR2_PACKAGE_GAME_FRAME
	bool "game-frame"
	depends on BR2_PACKAGE_FFMPEG
	select BR2_PACKAGE_FFMPEG_SWSCALE
	help
	  game-frame VIDEO SECONDS: a frame of a game's video as a PPM,
	  for covers the device's game-install makes from videos
	  (games.manifest "cover = VIDEO.bik:SECONDS"): the system's
	  ffmpeg has no ffmpeg program.
```

## board/common/buildroot/package/innoextract/Config.in
```kconfig
config BR2_PACKAGE_INNOEXTRACT
	bool "innoextract"
	depends on BR2_INSTALL_LIBSTDCPP
	depends on BR2_TOOLCHAIN_HAS_THREADS
	depends on BR2_USE_WCHAR
	select BR2_PACKAGE_BOOST
	select BR2_PACKAGE_BOOST_IOSTREAMS
	select BR2_PACKAGE_BOOST_FILESYSTEM
	select BR2_PACKAGE_BOOST_DATE_TIME
	select BR2_PACKAGE_BOOST_SYSTEM
	select BR2_PACKAGE_BOOST_PROGRAM_OPTIONS
	select BR2_PACKAGE_XZ
	help
	  Unpacks installers made with Inno Setup (GOG's setup_*.exe
	  and their .bin parts) without running them: the device's
	  game-install installs a game from its installer.

	  The master branch: the 1.9 release stops at Inno Setup 6.0.5,
	  GOG's newer installers are 6.1 to 6.4.

	  https://constexpr.org/innoextract/

comment "innoextract needs a toolchain w/ C++, threads, wchar"
	depends on !BR2_INSTALL_LIBSTDCPP || !BR2_TOOLCHAIN_HAS_THREADS || !BR2_USE_WCHAR
```

## board/common/buildroot/package/iortcw/Config.in
```kconfig
config BR2_PACKAGE_IORTCW
	bool "iortcw"
	depends on BR2_aarch64 || BR2_x86_64 # the game modules' names
	depends on BR2_INSTALL_LIBSTDCPP # its camera splines are C++
	depends on !BR2_STATIC_LIBS # sdl2, the game modules
	depends on BR2_PACKAGE_MESA_PANFROST # OpenGL through EGL
	# SDL2 with EGL and its bareapp video driver: the only window there is
	depends on BR2_PACKAGE_BARE_APP_SDL
	select BR2_PACKAGE_SDL2
	select BR2_PACKAGE_ZLIB
	help
	  iortcw (GPLv3 with id Software's additional terms), the engine
	  of Return to Castle Wolfenstein, single player: an SDL2 game for
	  bare_app, its OpenGL renderer drawn by the GPU (mesa-panfrost)
	  through SDL's bareapp driver, the gamepad by the bindings of
	  gamepad.cfg. The game files (main/ of a bought copy) are not
	  included.

	  https://github.com/iortcw/iortcw

comment "iortcw needs mesa-panfrost, bare_app's SDL2 games and a toolchain w/ C++, dynamic library"
	depends on BR2_aarch64 || BR2_x86_64
	depends on !BR2_PACKAGE_MESA_PANFROST || !BR2_PACKAGE_BARE_APP_SDL || \
		!BR2_INSTALL_LIBSTDCPP || BR2_STATIC_LIBS
```

## board/common/buildroot/package/openal-soft-win32/Config.in
```kconfig
config BR2_PACKAGE_OPENAL_SOFT_WIN32
	bool "openal-soft-win32"
	help
	  OpenAL Soft's 32-bit Windows DLL (soft_oal.dll, the official
	  binary release) in /usr/share/game-redist, where the device's
	  game-install finds the files a game's recipe takes from a PC:
	  The Book of Unwritten Tales plays its sound through it (as
	  OpenAL32.dll), so the player need not bring it.

	  https://openal-soft.org/
```

## board/common/buildroot/package/sdl12-compat/Config.in
```kconfig
config BR2_PACKAGE_SDL12_COMPAT
	bool "sdl12-compat"
	depends on !BR2_STATIC_LIBS # it loads SDL 2 at run time
	depends on !BR2_PACKAGE_SDL # the same libSDL-1.2.so.0
	select BR2_PACKAGE_SDL2
	help
	  SDL 1.2's API over SDL 2 (libSDL-1.2.so.0): old SDL 1.2
	  programs (and Box64's wrapped libSDL-1.2) get SDL 2's drivers,
	  here bare_app's. Patched to ask for desktop OpenGL where SDL 2
	  defaults to OpenGL ES (EGL without GLX).

	  https://github.com/libsdl-org/sdl12-compat

comment "sdl12-compat needs a toolchain w/ dynamic library and no SDL 1.2"
	depends on BR2_STATIC_LIBS || BR2_PACKAGE_SDL
```

## board/common/buildroot/package/serious-engine/Config.in
```kconfig
config BR2_PACKAGE_SERIOUS_ENGINE
	bool "serious-engine"
	depends on BR2_aarch64 || BR2_x86_64 # 64-bit fixes of the port
	depends on BR2_INSTALL_LIBSTDCPP
	depends on !BR2_STATIC_LIBS # the game libraries are dlopen'ed
	depends on BR2_TOOLCHAIN_HAS_THREADS
	depends on BR2_PACKAGE_MESA_PANFROST # OpenGL through EGL
	# SDL2 with EGL and its bareapp video driver: the only window there is
	depends on BR2_PACKAGE_BARE_APP_SDL
	select BR2_PACKAGE_SDL2
	select BR2_PACKAGE_ZLIB
	select BR2_PACKAGE_LIBVORBIS # the music (Ogg, dlopen'ed)
	help
	  Serious Engine 1.10 (Croteam's, GPLv2) as tx00100xt's
	  SeriousSamClassic port: Serious Sam: The First Encounter and
	  The Second Encounter for bare_app, drawn by the GPU
	  (mesa-panfrost) through SDL's bareapp driver, a gamepad in the
	  menus and the game, aim assist. The game files (the .gro files
	  and the rest of a bought copy) are not included.

	  https://github.com/tx00100xt/SeriousSamClassic

comment "serious-engine needs mesa-panfrost, bare_app's SDL2 games and a toolchain w/ C++, threads, dynamic library"
	depends on BR2_aarch64 || BR2_x86_64
	depends on !BR2_PACKAGE_MESA_PANFROST || !BR2_PACKAGE_BARE_APP_SDL || \
		!BR2_INSTALL_LIBSTDCPP || BR2_STATIC_LIBS || !BR2_TOOLCHAIN_HAS_THREADS
```

## board/common/buildroot/package/ut2004/Config.in
```kconfig
config BR2_PACKAGE_UT2004
	bool "ut2004"
	depends on BR2_aarch64 # box64
	depends on !BR2_STATIC_LIBS # box64, sdl12-compat
	select BR2_PACKAGE_BOX64
	select BR2_PACKAGE_SDL12_COMPAT
	help
	  The starter of Unreal Tournament 2004's Linux build (x86_64)
	  under Box64: /usr/bin/ut2004. The game itself is not included:
	  the game as the DVD's Linux installer leaves it (x86_64, with
	  its CD key in System/cdkey) goes to ut2004/ of the games
	  partition (/games), games/games.manifest [ut2004].
```
